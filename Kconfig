## Kconfig
```kconfig
# mainmenu Wookey embdedded OS configuration"
mainmenu "Wookey configuration"

menu "General Setup"

config PROJ_NAME
    string "Wookey project name"
    default "wookey"
    help
      set the projet name.

config PROJ_FILES
    string "Wookey project files dir"
    default "."
    help
      set the parent dir of the project output file.
      can be set to any existing directory.

# hidden to user, based on PROJ_NAME
config BIN_NAME
    string
    default "$(CONFIG_PROJ_NAME).bin"

config HEX_NAME
    string
    default "$(CONFIG_PROJ_NAME).hex"

config ELF_NAME
    string
    default "$(CONFIG_PROJ_NAME).elf"
# end of hidden

config BUILD_DIR
    string "project output build directory name"
    default "build"
    help
      set the build directory.

config PRIVATE_DIR
    string "project output private directory name"
    default "private"
    help
      set the private directory path, relative to current project dir.
      If this directory already exist, the private content (key pairs, etc.)
      are not regenerated.

endmenu

menu "Micro-Kernel configuration"

source "kernel/Kconfig"

endmenu

source "loader/Kconfig"

menu "Userspace drivers and features"

source "drivers/Kconfig"

source "libs/Kconfig"

source "apps/Kconfig"


endmenu

menu "External tooling and libs"

source "externals/Kconfig"

endmenu


menu "Block device FDE (Full Disk Encryption) options"

choice
   prompt "SCSI block size"
   default USB_DEV_SCSI_BLOCK_SIZE_4096
   ---help---
      Set the SCSI block size reported to the host. The standard
      size is 512 bytes. However, for performance reasons, 4K blocks
      are a better choice if the OS supports it (modern Operating Systems
      should do so). If you might use your USB thumb drive on old systems,
      choose the more conservative 512 bytes block size.
      WARNING: >= 8K blocks might not be well supported by hosts, choose at your
      own risks!
   config USB_DEV_SCSI_BLOCK_SIZE_512
      bool "SCSI blocks of 512 bytes"
   config USB_DEV_SCSI_BLOCK_SIZE_1024
      bool "SCSI blocks of 1024 bytes"
   config USB_DEV_SCSI_BLOCK_SIZE_2048
      bool "SCSI blocks of 2048 bytes"
   config USB_DEV_SCSI_BLOCK_SIZE_4096
      bool "SCSI blocks of 4096 bytes"
   config USB_DEV_SCSI_BLOCK_SIZE_8192
      bool "SCSI blocks of 8192 bytes"
endchoice

choice
   prompt "Block device FDE (Full Disk Encryption) algorithm and mode"
   default AES256_CBC_ESSIV
   config AES256_CBC_ESSIV
      bool "AES256-CBC-ESSIV"
      ---help---
      AES with a 256-bit key, CBC-ESSIV mode.
   config TDES_CBC_ESSIV
      bool "TDES-CBC-ESSIV"
      ---help---
      TDES with a 168-bit key, CBC-ESSIV mode.
endchoice
endmenu

source "Kconfig.gen"

menu "Firmware options"

choice
   prompt "Firmware generation mode"
   default FIRMWARE_MODE_DUAL_BANK
   config FIRMWARE_MODE_MONO_BANK
      bool "Mono-bank firmware mode without DFU support"
      ---help---
        Single firmware mode, without DFU support. This mode
        generates a single image of the content profile, with
        no DFU profile concatenated.
        This can be used for application testing, but is not
        recommanded for production.
   config FIRMWARE_MODE_MONO_BANK_DFU
      bool "Mono-bank firmware mode with DFU support"
      ---help---
        Single firmware mode, with DFU support. This mode
        generates a single image of the content profile, with
        a DFU profile concatenated. This permits to update the
        firmware bank by the DFU but not the DFU itself.
        This can be used for embedded sytstems where there is not
        enough space for dual-bank firmwares. This is less secure
        than the dual-bank with DFU profile
   config FIRMWARE_MODE_DUAL_BANK
      bool "Dual-bank firmware mode without DFU support"
      depends on STM32F439
      ---help---
        Dual firmware mode, without DFU support. This mode
        generates a dual-bank image of the content profile, with
        no DFU profile concatenated.
        This can be used for application testing in both banks.
        The device can't be updated through DFU, and requires a JTAG
        interface for update. This is resilient but *not* secure.
   config FIRMWARE_MODE_DUAL_BANK_DFU
      bool "Dual-bank firmware mode with DFU support"
      depends on STM32F439
      ---help---
        Dual firmware mode, with dual DFU support. This mode
        generates a dual-bank image of the content profile, with
        a dual-bank DFU profile concatenated.
        This permits to update both firmware and DFU profiles in
        production keeping resilient properties. This requires
        enough flash in the target.
endchoice

choice
   prompt "Firmware build mode"
   default FIRMWARE_BUILD_MODE_DEBUG
   config FIRMWARE_BUILD_MODE_DEBUG
     bool "Build the firmware in debug mode"
     ---help---
       Keep debug flags and local UART activated. Freeze on panic,
       no RDP2 check at boot time.
   config FIRMWARE_BUILD_MODE_PROD
     bool "Build the firmware in prod mode"
     select KERNEL_NOSERIAL
     select KERNEL_PANIC_REBOOT
     select LOADER_FLASH_LOCK
     ---help---
       Deactivate all debug, deactivate local uart, make the firmware
       reboot in case of panic, activate the RDP2 flag check at boot
       reseting when bootable firmware version is greater than 0.
endchoice


config FIRMWARE_DUALBANK
  bool
  default y if FIRMWARE_MODE_DUAL_BANK || FIRMWARE_MODE_DUAL_BANK_DFU
  default n

config FIRMWARE_DFU
  bool
  default y if FIRMWARE_MODE_MONO_BANK_DFU || FIRMWARE_MODE_DUAL_BANK_DFU
  default n

endmenu

menu "Global compile options"

choice
   prompt "Optimization flags"
   default OPTIM_NONE
   config OPTIM_NONE
     bool "Only basics. No impact on code structure"
   config OPTIM_PERF1
     bool "Set -O1 compile flags"
     help
      if set, the project will be compiled using debug flags and witht
      compile-time optimization set at -O1.
   config OPTIM_PERF2
     bool "Set -O2 compile flags"
     help
      if set, the project will be compiled using debug flags and witht
      compile-time optimization set at -O2.
   config OPTIM_PERF3
     bool "Set -O3 compile flags"
     help
      if set, the project will be compiled using debug flags and witht
      compile-time optimization set at -O3.
   config OPTIM_SIZE
     bool "Set size compile flags optimization (debug keeped)"
     help
      if set, the project will be compiled using debug flags and without
      compile-time optimization.
endchoice

# hidden config done marker for root Makefile
config DBGFLAGS_GCC
  string
  default "-g3 -finline-functions-called-once -fipa-pure-const -fmerge-constants -O0" if DEBUG && OPTIM_NONE
  default "-g3 -fno-caller-saves -fno-cse-follow-jumps -fno-hoist-adjacent-loads -fno-inline-small-functions -fno-optimize-sibling-calls -fno-peephole2 -fno-reorder-functions -fno-rerun-cse-after-loop -fno-tree-vrp -fno-reorder-blocks -fno-tree-vect-loop-version -finline-functions-called-once -fno-align-functions  -fno-align-jumps  -fno-align-loops -fno-align-labels -fno-reorder-blocks-and-partition  -fno-prefetch-loop-arrays -finline-functions-called-once -fipa-pure-const -fmerge-constants -Os" if DEBUG && OPTIM_SIZE
  default "-ggdb -O1" if DEBUG && OPTIM_PERF1
  default "-ggdb -O2" if DEBUG && OPTIM_PERF2
  default "-ggdb -O3" if DEBUG && OPTIM_PERF3

config DBGFLAGS_LLVM
  string
  default "-g3 -finline-functions-called-once -fipa-pure-const -fmerge-constants -O0" if DEBUG && OPTIM_NONE
  default "-g3 -Os" if DEBUG && OPTIM_SIZE
  default "-ggdb -O1" if DEBUG && OPTIM_PERF1
  default "-ggdb -O2" if DEBUG && OPTIM_PERF2
  default "-ggdb -O3" if DEBUG && OPTIM_PERF3



config STACK_PROT_FLAG
    bool "Activate -fstack-protection-strong"
    default y

# invisible by now... as consider as fixed
config WARNFLAGS_GCC
    string
    default "-Wall -Werror -Wextra -Wno-reserved-id-macro -Wno-padded -Wno-packed -Wno-covered-switch-default -Wno-used-but-marked-unused -Wno-unused-but-set-variable -Wno-unused-function -Werror"

config WARNFLAGS_LLVM
    string
    default "-fintegrated-as -fno-builtin -Wno-error=unused-command-line-argument -Wno-incompatible-library-redeclaration -Wall -Werror -Wextra -Wno-reserved-id-macro -Wno-padded -Wno-packed -Wno-covered-switch-default -Wno-used-but-marked-unused -Wno-unused-function -Werror"

config STACKPROTFLAGS
    string
    default "-fstack-protector-strong"
    depends on STACK_PROT_FLAGS


config EMBEDCFLAGS
    string
    default "-fno-builtin -nostdlib -D_FORTIFY_SOURCE=2"


config EC_UTILS
  string
  default "tools/ec_utils"


config DONE
  bool
  default y

endmenu
```

## apps/Kconfig
```kconfig
menu "Applications"

comment "Configuring Applications"

source "apps/Kconfig.gen"

comment "Configuring communication permissions for appliations"

menu "Applications IPC and SHM"

# this config (invisible to user) is used only to force IPC config
# to y, making the IPC matrix starting with a comprehensive associated config
config NEED_IPC
  bool
  select IPC
  default y

config IPC
  bool "Allow communicating using kernel IPC"
  default y

if IPC

source "apps/ipc.config"

endif

config DMA_SHM
  bool "Allow Sharing DMA buffer beetween tasks"
  default n
  ---help---
  if y, tasks are allowed to declare buffers that
  can be used by other tasks as source (or destination)
  of DMA transactions to improve performances. This
  require two permissions: one for the task to share
  the DMA buffer, one for the peer to use the shared
  DMA buffer. See EwoK API for more information.

if DMA_SHM

source apps/dmashm.config

endif

endmenu

config SHM
  bool
  default y

config FIRMWARE
  bool
  depends on STM32F4
  default y



endmenu
```

## drivers/Kconfig
```kconfig
menu "Userspace drivers library pool"

#
# TODO: CFLAGS auto update works because relative path of apps with project
# root dir is ../.., but it is not clean. Using PROJ_FILES should be better
# The goal here is to dynamically update APPS_CFLAGS with the api/ dir of
# each compiled userspace driver, avoiding manual update of apps Makefiles
#

source "drivers/Kconfig.gen"

# drivers generic options

choice
  prompt "Drivers specific optimization flags"
  default DRV_OPTIM_NONE
  config DRV_OPTIM_NONE
     bool "No specific flags, same as other SDK parts"
     help
      if set, the driject will be compiled using global SDK optimization
      flags.
  config DRV_OPTIM_PERF1
     bool "Set -O1 compile flags"
     help
      if set, the drivers will be compiled using debug flags and witht
      compile-time optimization set at -O1.
  config DRV_OPTIM_PERF2
     bool "Set -O2 compile flags"
     help
      if set, the drivers will be compiled using debug flags and witht
      compile-time optimization set at -O2.
  config DRV_OPTIM_PERF3
     bool "Set -O3 compile flags"
     help
      if set, the drivers will be compiled using debug flags and witht
      compile-time optimization set at -O3.
  config DRV_OPTIM_SIZE
     bool "Set size compile flags optimization"
     help
      if set, the drivers will be compiled using debug flags and with
      compile-time optimization set at -Os.
endchoice

config DRIVERS_CFLAGS
  string
  default "" if DRV_OPTIM_NONE
  default "-O1" if DRV_OPTIM_PERF1
  default "-O2" if DRV_OPTIM_PERF2
  default "-O3" if DRV_OPTIM_PERF3
  default "-Os" if DRV_OPTIM_SIZE

endmenu
```

## externals/Kconfig
```kconfig
config EXTERNALS
  bool "Compile externals"
  default y
  ---help---
  Support for external tools such as libecc

if EXTERNALS

config LIBSIGN
  bool
# FIXME: All this part is for libecc. Libecc is an external component and
# should be passed into another dir (not libs) as its build mechanism and
# configuration part (below part) is not a part of the libecc project.
config USR_LIB_SIGN
  bool  "userspace libsign support"
  default y
  select USR_LIB_RNG
  ---help---
  Support for cryptographic signature support in usersapce.
config USR_LIB_SIGN_CFLAGS
  string
  default " -I../../externals/libecc/src " if USR_LIB_SIGN

menu "libsign features"
  depends on USR_LIB_SIGN

choice
  prompt "Libsign Eliptic Curve name"
  default ECC_CURVENAME_FR256
config ECC_CURVENAME_FR256
  bool "FRP256V1"
config ECC_CURVENAME_SP256
  bool "SECP256R1"
config ECC_CURVENAME_BP256
  bool "BRAINPOOLP256R1"
endchoice
# auto curvname string
config ECC_CURVNAME
  string
  default "FRP256V1"        if ECC_CURVENAME_FR256
  default "SECP256R1"       if ECC_CURVENAME_SP256
  default "BRAINPOOLP256R1" if ECC_CURVENAME_BP256

endmenu

config GP_PRO
   bool "GlobalPlatform Pro toolkit"
   default n

config ANT_JAVACARD
   bool "Ant Javacard toolkit"
   default n

config SECAES
   bool "Secure STM32 software AES"
   default n

endif
```

## libs/Kconfig
```kconfig
menu "Userspace utility libraries"

#
# TODO: CFLAGS auto update works because relative path of apps with project
# root dir is ../.., but it is not clean. Using PROJ_FILES should be better
# The goal here is to dynamically update APPS_CFLAGS with the api/ dir of
# each compiled userspace driver, avoiding manual update of apps Makefiles
#

# generic libs inclusion
source "libs/Kconfig.gen"


choice
  prompt "Libraries specific optimization flags"
  default LIB_OPTIM_NONE
  config LIB_OPTIM_NONE
     bool "No specific flags, same as other SDK parts"
     help
      if set, the driject will be compiled using global SDK optimization
      flags.
  config LIB_OPTIM_PERF1
     bool "Set -O1 compile flags"
     help
      if set, the libraries will be compiled using debug flags and witht
      compile-time optimization set at -O1.
  config LIB_OPTIM_PERF2
     bool "Set -O2 compile flags"
     help
      if set, the libraries will be compiled using debug flags and witht
      compile-time optimization set at -O2.
  config LIB_OPTIM_PERF3
     bool "Set -O3 compile flags"
     help
      if set, the libraries will be compiled using debug flags and witht
      compile-time optimization set at -O3.
  config LIB_OPTIM_SIZE
     bool "Set size compile flags optimization"
     help
      if set, the libraries will be compiled using debug flags and with
      compile-time optimization set at -Os.
endchoice

config LIB_OPTIM_CFLAGS
  string
  default "" if LIB_OPTIM_NONE
  default "-O1" if LIB_OPTIM_PERF1
  default "-O2" if LIB_OPTIM_PERF2
  default "-O3" if LIB_OPTIM_PERF3
  default "-Os" if LIB_OPTIM_SIZE

endmenu
```
